## conf/distro/my-distro.conf
```bitbake
# my-distro.conf
# Custom distro for my-project

DISTRO = "my-distro"
DISTRO_NAME = "My Project Distro"
DISTRO_VERSION = "1.0.0"

UBOOT_EXTLINUX_MENU_TITLE = "L4T boot options"
UBOOT_EXTLINUX_DEFAULT = "primary"
UBOOT_EXTLINUX_LABELS = "primary"
UBOOT_EXTLINUX_MENU_DESCRIPTION_primary = "primary"
UBOOT_EXTLINUX_KERNEL_IMAGE_primary = "/boot/Image2"
UBOOT_EXTLINUX_FDT_primary = "devicetree/tegra234-p3768-0000+p3767-0004-nv-super.dtb"
UBOOT_EXTLINUX_FDTOVERLAYS_primary = "devicetree/tegra234-p3767-camera-p3768-imx219-C.dtbo"
UBOOT_EXTLINUX_INITRD_primary = "/boot/initrd"
UBOOT_EXTLINUX_KERNEL_ARGS_primary = "mminit_loglevel=4 console=ttyTCU0,115200 firmware_class.path=/etc/firmware fbcon=map:0 nospectre_bhb con"

KERNEL_DEVICETREE_OVERLAYS = "tegra234-p3767-camera-p3768-imx219-C.dtbo"

DISTRO_FEATURES:append = " opengl wayland vulkan systemd virtualization usrmerge"
```

## conf/layer.conf
```bitbake
# We have a conf and classes directory, add to BBPATH
BBPATH .= ":${LAYERDIR}"

# We have recipes-* directories, add to BBFILES
BBFILES += "${LAYERDIR}/recipes-*/*/*.bb \
            ${LAYERDIR}/recipes-*/*/*.bbappend"

BBFILE_COLLECTIONS += "meta-my-project"
BBFILE_PATTERN_meta-my-project = "^${LAYERDIR}/"
BBFILE_PRIORITY_meta-my-project = "6"

LAYERDEPENDS_meta-my-project = "core"
LAYERSERIES_COMPAT_meta-my-project = "scarthgap"
```
